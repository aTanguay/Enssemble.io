## AmyBoard/NSMBL_Bridge/sdkconfig.defaults
```kconfig
# Target — AMYboard (ESP32-S3)
CONFIG_IDF_TARGET="esp32s3"

# Bluetooth (NimBLE, peripheral only)
CONFIG_BT_ENABLED=y
CONFIG_BT_NIMBLE_ENABLED=y
CONFIG_BT_NIMBLE_ROLE_PERIPHERAL=y
CONFIG_BT_NIMBLE_ROLE_CENTRAL=n
CONFIG_BT_NIMBLE_ROLE_OBSERVER=n
CONFIG_BT_NIMBLE_ROLE_BROADCASTER=n
CONFIG_BT_NIMBLE_MAX_CONNECTIONS=1

# Main task stack
CONFIG_ESP_MAIN_TASK_STACK_SIZE=8192

# Logging
CONFIG_LOG_DEFAULT_LEVEL_INFO=y

# Console on the S3's native USB (USB-Serial-JTAG) so logs are visible over the
# same USB-C used to flash. DIN MIDI is on UART1 (GPIO14/21) — a different
# peripheral entirely — so there is no console/MIDI collision here.
CONFIG_ESP_CONSOLE_UART_DEFAULT=n
CONFIG_ESP_CONSOLE_USB_SERIAL_JTAG=y
CONFIG_ESP_CONSOLE_SECONDARY_NONE=y
```

## AmyBoard/NSMBL_Kneel/sdkconfig.defaults
```kconfig
# Target
CONFIG_IDF_TARGET="esp32s3"

# Bluetooth
CONFIG_BT_ENABLED=y
CONFIG_BT_NIMBLE_ENABLED=y
CONFIG_BT_NIMBLE_ROLE_PERIPHERAL=y
CONFIG_BT_NIMBLE_ROLE_CENTRAL=n
CONFIG_BT_NIMBLE_ROLE_OBSERVER=n
CONFIG_BT_NIMBLE_ROLE_BROADCASTER=n

# BLE connection parameters
CONFIG_BT_NIMBLE_MAX_CONNECTIONS=1

# PSRAM
CONFIG_SPIRAM=y
CONFIG_SPIRAM_MODE_OCT=y
CONFIG_SPIRAM_SPEED_80M=y

# FAT filesystem — long filenames required for kit files
CONFIG_FATFS_LFN_HEAP=y
CONFIG_FATFS_MAX_LFN=255

# Logging
CONFIG_LOG_DEFAULT_LEVEL_INFO=y
```

## AmyBoard/NSMBL_Synth/sdkconfig.defaults
```kconfig
# Target
CONFIG_IDF_TARGET="esp32s3"

# Bluetooth
CONFIG_BT_ENABLED=y
CONFIG_BT_NIMBLE_ENABLED=y
CONFIG_BT_NIMBLE_ROLE_PERIPHERAL=y
CONFIG_BT_NIMBLE_ROLE_CENTRAL=n
CONFIG_BT_NIMBLE_ROLE_OBSERVER=n
CONFIG_BT_NIMBLE_ROLE_BROADCASTER=n

# BLE connection parameters
CONFIG_BT_NIMBLE_MAX_CONNECTIONS=1

# PSRAM
CONFIG_SPIRAM=y
CONFIG_SPIRAM_MODE_OCT=y
CONFIG_SPIRAM_SPEED_80M=y

# Main task stack size (AMY init is heavy)
CONFIG_ESP_MAIN_TASK_STACK_SIZE=16384

# Logging
CONFIG_LOG_DEFAULT_LEVEL_INFO=y
```

## SeeedXiaoMIDI/NSMBL_Synth/sdkconfig.defaults
```kconfig
# Target — XIAO ESP32-C3
CONFIG_IDF_TARGET="esp32c3"

# Bluetooth
CONFIG_BT_ENABLED=y
CONFIG_BT_NIMBLE_ENABLED=y
CONFIG_BT_NIMBLE_ROLE_PERIPHERAL=y
CONFIG_BT_NIMBLE_ROLE_CENTRAL=n
CONFIG_BT_NIMBLE_ROLE_OBSERVER=n
CONFIG_BT_NIMBLE_ROLE_BROADCASTER=n

# BLE connection parameters
CONFIG_BT_NIMBLE_MAX_CONNECTIONS=1

# Main task stack size
CONFIG_ESP_MAIN_TASK_STACK_SIZE=8192

# Console via USB-Serial-JTAG (frees UART0 for SAM2695).
# CRITICAL: UART0 is the SAM2695 MIDI port. If the console stays on UART0, every
# log line is transmitted to the chip as garbage MIDI and corrupts its state
# (stuck/wrong patch, intermittent behavior). Keep the console OFF UART0.
CONFIG_ESP_CONSOLE_UART_DEFAULT=n
CONFIG_ESP_CONSOLE_USB_SERIAL_JTAG=y
CONFIG_ESP_CONSOLE_SECONDARY_NONE=y

# Logging
CONFIG_LOG_DEFAULT_LEVEL_INFO=y
```
